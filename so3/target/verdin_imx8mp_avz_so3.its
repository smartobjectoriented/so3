## so3/target/verdin_imx8mp_avz_so3.its
```
/*
 * Copyright (C) 2026 EDGEMTech SA <info@edgemtech.ch>
 *
 * This program is free software; you can redistribute it and/or modify
 * it under the terms of the GNU General Public License version 2 as
 * published by the Free Software Foundation.
 *
 * This program is distributed in the hope that it will be useful,
 * but WITHOUT ANY WARRANTY; without even the implied warranty of
 * MERCHANTABILITY or FITNESS FOR A PARTICULAR PURPOSE.  See the
 * GNU General Public License for more details.
 *
 * You should have received a copy of the GNU General Public License
 * along with this program; if not, write to the Free Software
 * Foundation, Inc., 51 Franklin St, Fifth Floor, Boston, MA  02110-1301  USA
 *
 */

/dts-v1/;

/ {
	description = "AVZ hypervisor + SO3 guest for the Toradex Verdin iMX8MP";

	images {
		avz {
			description = "AVZ Hypervisor (64-bit) Polymorphic SO3";
			data = /incbin/("../../avz/so3.bin");
			type = "kernel";
			os = "linux";
			arch = "arm64";
			compression = "none";
			load = <0x40080000>;
			entry = <0x40080000>;
		};

		avz_dt {
			description = "AVZ flattened device tree blob";
			data = /incbin/("../../avz/dts/verdin-imx8mp_avz.dtb");
			type = "avz_dt";
			arch = "arm64";
			compression = "none";
			load = <0x46000000>;
		};

		so3 {
			description = "SO3 OS kernel (guest)";
			data = /incbin/("../so3/so3.bin");
			type = "guest";
			arch = "arm64";
			os = "linux";
			compression = "none";
			load = <0x48000000>;
			entry = <0x48000000>;
		};

		fdt {
			description = "SO3 guest flattened device tree blob";
			data = /incbin/("../so3/dts/verdin-imx8mp.dtb");
			type = "flat_dt";
			arch = "arm64";
			compression = "none";
			load = <0x50200000>;
		};

		ramfs {
			description = "SO3 environment minimal rootfs";
			data = /incbin/("../rootfs/rootfs.fat");
			type = "ramdisk";
			arch = "arm64";
			os = "linux";
			compression = "none";
			load = <0x50c00000>;
		};
	};

	configurations {
		default = "so3_guest";

		so3_guest {
			description = "SO3 kernel image including device tree";
			kernel = "avz";
			loadables = "avz_dt", "so3";
			fdt = "fdt";
			ramdisk = "ramfs";
		};
	};
};
```

## so3/target/verdin_imx8mp_so3.its
```
/*
 * Copyright (C) 2026 EDGEMTech SA <info@edgemtech.ch>
 *
 * This program is free software; you can redistribute it and/or modify
 * it under the terms of the GNU General Public License version 2 as
 * published by the Free Software Foundation.
 *
 * This program is distributed in the hope that it will be useful,
 * but WITHOUT ANY WARRANTY; without even the implied warranty of
 * MERCHANTABILITY or FITNESS FOR A PARTICULAR PURPOSE.  See the
 * GNU General Public License for more details.
 *
 * You should have received a copy of the GNU General Public License
 * along with this program; if not, write to the Free Software
 * Foundation, Inc., 51 Franklin St, Fifth Floor, Boston, MA  02110-1301  USA
 *
 */

/dts-v1/;

/ {
	description = "SO3 standalone (bare-metal) for the Toradex Verdin iMX8MP";

	images {
		so3 {
			description = "SO3 OS kernel";
			data = /incbin/("../so3/so3.bin");
			type = "kernel";
			os = "linux";
			arch = "arm64";
			compression = "none";
			load = <0x41080000>;
			entry = <0x41080000>;
		};

		fdt {
			description = "Flattened Device Tree blob";
			data = /incbin/("../so3/dts/verdin-imx8mp_standalone.dtb");
			type = "flat_dt";
			arch = "arm64";
			compression = "none";
			load = <0x44a00000>;
		};

		ramfs {
			description = "SO3 environment minimal rootfs";
			data = /incbin/("../rootfs/rootfs.fat");
			type = "ramdisk";
			arch = "arm64";
			os = "linux";
			compression = "none";
			load = <0x44c00000>;
		};
	};

	configurations {
		default = "so3_ramfs";

		so3_ramfs {
			description = "SO3 kernel image including device tree";
			kernel = "so3";
			fdt = "fdt";
			ramdisk = "ramfs";
		};
	};
};
```

## so3/target/verdin_imx8mp_so3_guest.its
```
/*
 * Copyright (C) 2026 EDGEMTech SA <info@edgemtech.ch>
 *
 * SO3 guest ITB for the Toradex Verdin iMX8MP. Carries the SO3 OS kernel
 * (guest) + its device tree + minimal rootfs. Paired with
 * verdin_imx8mp_avz.itb and loaded by U-Boot's e1c-boot command, which
 * passes this ITB to AVZ in x1; AVZ's loadAgency() loads the agency guest
 * from it.
 *
 * This program is free software; you can redistribute it and/or modify
 * it under the terms of the GNU General Public License version 2 as
 * published by the Free Software Foundation.
 *
 */

/dts-v1/;

/ {
	description = "SO3 guest bundle for the Toradex Verdin iMX8MP";

	images {
		so3 {
			description = "SO3 OS kernel (guest)";
			data = /incbin/("../so3/so3.bin");
			type = "guest";
			arch = "arm64";
			os = "linux";
			compression = "none";
			load = <0x48000000>;
			entry = <0x48000000>;
		};

		fdt {
			description = "SO3 guest flattened device tree blob";
			data = /incbin/("../so3/dts/verdin-imx8mp.dtb");
			type = "flat_dt";
			arch = "arm64";
			compression = "none";
			load = <0x50200000>;
		};

		ramfs {
			description = "SO3 environment minimal rootfs";
			data = /incbin/("../rootfs/rootfs.fat");
			type = "ramdisk";
			arch = "arm64";
			os = "linux";
			compression = "none";
			load = <0x50c00000>;
		};
	};

	configurations {
		default = "capsule";

		capsule {
			description = "SO3 guest on Verdin iMX8MP";
			loadables = "so3";
			fdt = "fdt";
			ramdisk = "ramfs";
		};
	};
};
```

## target/virt64_so3_guest.its
```
/*
 * Copyright (C) 2020-2025 Daniel Rossier <daniel.rossier@heig-vd.ch>
 *
 * This program is free software; you can redistribute it and/or modify
 * it under the terms of the GNU General Public License version 2 as
 * published by the Free Software Foundation.
 *
 * This program is distributed in the hope that it will be useful,
 * but WITHOUT ANY WARRANTY; without even the implied warranty of
 * MERCHANTABILITY or FITNESS FOR A PARTICULAR PURPOSE.  See the
 * GNU General Public License for more details.
 *
 * You should have received a copy of the GNU General Public License
 * along with this program; if not, write to the Free Software
 * Foundation, Inc., 51 Franklin St, Fifth Floor, Boston, MA  02110-1301  USA
 *
 */

/dts-v1/;

/ {
	description = "Kernel and rootfs components for virt64 (armv8) environment";

	images {
		avz {
			description = "AVZ Hypervisor (64-bit) Polymorphic SO3";
            data = /incbin/("../avz/so3.bin");
			type = "kernel";
            os = "linux";
			arch = "arm64";
			compression = "none";
			load = <0x40080000>;
			entry = <0x40080000>;
		};
 		
		avz_dt {
			description = "Flattened Device Tree blob";
			data = /incbin/("../avz/dts/virt64_avz.dtb");
			type = "avz_dt";
			arch = "arm64";
			compression = "none";
			load = <0x46000000>;
		};

		so3 {
			description = "SO3 OS kernel";
			data = /incbin/("../so3/so3.bin");
			type = "guest";
			arch = "arm64";
			os = "linux";
			compression = "none";
            load = <0x41080000>;
			entry = <0x41080000>;
		};
 
        fdt {
			description = "Flattened Device Tree blob";
			data = /incbin/("../so3/dts/virt64.dtb");
			type = "flat_dt";
			arch = "arm64";
			compression = "none";
			load = <0x43000000>;
		};	

        ramfs {
        	description = "SO3 environment minimal rootfs";
			data = /incbin/("../rootfs/rootfs.fat");
			type = "ramdisk";
			arch = "arm64";
			os = "linux";
			compression = "none";
			load = <0x43500000>;
    	};
                
	};

	configurations {
		default = "so3_guest";
                
		so3_guest {
			description = "SO3 kernel image including device tree";
		    kernel = "avz";
            loadables = "avz_dt", "so3"; 
			fdt = "fdt";
            ramdisk = "ramfs"; 
		};
	};
};
```
