/*
 * Copyright (C) 2022 David Truan <david.truan@heig-vd.ch>
 *
 * This program is free software; you can redistribute it and/or modify
 * it under the terms of the GNU General Public License version 2 as
 * published by the Free Software Foundation.
 *
 * This program is distributed in the hope that it will be useful,
 * but WITHOUT ANY WARRANTY; without even the implied warranty of
 * MERCHANTABILITY or FITNESS FOR A PARTICULAR PURPOSE.  See the
 * GNU General Public License for more details.
 *
 * You should have received a copy of the GNU General Public License
 * along with this program; if not, write to the Free Software
 * Foundation, Inc., 51 Franklin St, Fifth Floor, Boston, MA  02110-1301  USA
 *
 */

/dts-v1/;

#include "soo.dtsi"

&ME {
	/* 16 MB should be enough for major cases. */
	domain-size = <0x1000000>;
	
	/* SPID on 64-bit encoding */
	spid = /bits/ 64 <0x0010000000000004>;
	
	/* SPAD capabilities on 64-bit encoding */
	spadcaps = /bits/ 64 <0x0000000000000000>;
	
	/* Name of this ME */
	me_name = "SOO.chat";
	
	/* Short description */
	me_shortdesc =
			
"SOO.chat is a live chat ME to distribute message across the network";

	frontends {
	
		/* Enabling the console */
		vuart {
			status = "ok";
		};

		vuihandler {
			status = "ok";
		};
		
	};
};
			
