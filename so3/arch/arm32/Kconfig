## so3/arch/arm32/Kconfig
```kconfig
if ARCH_ARM32

menu "Platform"

config KERNEL_VADDR
	 
	hex "Virtual base address of kernel space"
	
choice
  prompt "Target"
	
	config VIRT32
    		bool "QEMU virt 32-bit machine"
	
	config RPI4    	
    		bool "Raspberry Pi 4 Model B support"
 		
endchoice

endmenu

endif
```

## so3/arch/arm32/merida/Kconfig
```kconfig
config RAM_BASE
	depends on MERIDAv2
	hex "RAM Memory physical base address"
	default 0x40000000
```

## so3/arch/arm32/rpi4/Kconfig
```kconfig
config RAM_BASE
	depends on RPI4 && !SO3VIRT
	hex "RAM Memory physical base address"
	default 0x00000000

config RAM_SIZE
        depends on RPI4
        hex "RAM memory size (Up to the hypervisor)"
        default 0x3f000000
```

## so3/arch/arm32/vexpress/Kconfig
```kconfig
config RAM_BASE
	depends on VEXPRESS
	hex "RAM Memory physical base address"
	default 0x80000000

config RAM_SIZE
        depends on VEXPRESS
        hex "RAM memory size (Up to the hypervisor)"
        default 0x3f000000
        
```

## so3/arch/arm32/virt32/Kconfig
```kconfig
config RAM_BASE
	depends on VIRT32
	hex "RAM Memory physical base address"
	default 0x40000000

config RAM_SIZE
        depends on VIRT32
        hex "RAM memory size (Up to the hypervisor)"
        default 0x3f000000
        
```

## so3/arch/arm64/Kconfig
```kconfig
if ARCH_ARM64

menu "Platform"

	config ARM64VT
		depends on AVZ
		bool "Virtualization support (ARM64 VT)"
		help
	  	  Enabling support of CPU virtualization extensions.
  
	choice
  		prompt "Target"
	
		config VIRT64
    		bool "Generic QEMU virt64 model"
	
		config RPI4_64
			bool "Raspberry Pi 4 64-bit"
			
	endchoice
		
	choice
    	prompt "Virtual address space size"
		help
		  Allows choosing one of multiple possible virtual address
		  space sizes. The level of translation table is determined by
		  a combination of page size and virtual address space size.
		  
        config VA_BITS_39
                bool "39-bit"
                
        config VA_BITS_48
                bool "48-bit"
        
	endchoice
                
source "arch/arm64/virt64/Kconfig"
source "arch/arm64/rpi4_64/Kconfig"

endmenu

endif
```

## so3/arch/arm64/rpi4_64/Kconfig
```kconfig
config RAM_BASE
	depends on RPI4_64
	hex "RAM Memory physical base address"
	default 0x00000000

config RAM_SIZE
        depends on RPI4_64 && !ARM64VT
        hex "RAM memory size (Up to the hypervisor)"
        default 0x3f000000
```

## so3/arch/arm64/virt64/Kconfig
```kconfig
config RAM_BASE
	depends on VIRT64
	hex "RAM Memory physical base address"
	default 0x40000000

config RAM_SIZE
        depends on VIRT64 && !ARM64VT
        hex "RAM memory size (Up to the hypervisor)"
        default 0x3f000000
```

## so3/arch/riscv64/Kconfig
```kconfig
menu "Platform"

choice
	prompt "SO3 OS type"

config STANDALONE
        bool "Standalone OS"

endchoice

choice
  prompt "Target"

	config VIRT_RISCV64
    		bool "Virt Riscv64"

endchoice

config RAM_BASE
	hex "RAM Memory physical base address"
	default 0x00000000

endmenu
```
