## so3/devices/Kconfig
```kconfig
menu "Drivers"

config UART
	bool "Driver UART"
    
config I2C
	bool "Driver I2C"
		
source "devices/serial/Kconfig"
source "devices/mmc/Kconfig"
source "devices/ramdev/Kconfig"
source "devices/timer/Kconfig"
source "devices/irq/Kconfig"
source "devices/i2c/Kconfig"
source "devices/rpisense/Kconfig"


endmenu
```

## so3/devices/fb/Kconfig
```kconfig
if FB
config PL111_CLCD
	bool "PL111 CLCD framebuffer device"
	depends on VIRT32 || VIRT64

config QEMU_RAMFB
	bool "QEMU RAMFB Framebuffer device"
	depends on VIRT32 || VIRT64

config SOO_FB
	bool "SOO Virtualized FB device"
	depends on SOO && !AVZ
endif
```

## so3/devices/input/Kconfig
```kconfig
config PL050_KMI
	bool "PL050 Keyboard/Mouse Interface"
	depends on VIRT32 || VIRT64

config SOO_INPUT
	bool "SOO Virtualized input device"
	depends on SOO && !AVZ
```

## so3/devices/irq/Kconfig
```kconfig
config GIC
	bool "Generic IRQ Controller"
	
config SOO_IRQ
	bool "SOO Virtualized IRQ controller device"
	depends on SOO && !AVZ
```

## so3/devices/timer/Kconfig
```kconfig
config SP804
	bool "SP804 Timer"
	depends on VEXPRESS
	
config ARM_TIMER
	bool "ARM architected CP15 timer for clocksource & clockevent"

config SOO_TIMER
	bool "SOO Virtualized timer device"
	depends on SOO && !AVZ
```

## so3/kernel/Kconfig
```kconfig
choice
	prompt "SO3 Execution mode"

	config THREAD_ENV
    	bool "Thread mode (no process)"
    	select APP_DEFAULT
    	
    config PROC_ENV
        bool "Process mode (looking for a init proc like a shell)"
        depends on MMU
        depends on !ROOTFS_NONE
        select FS_FAT

endchoice

menu "Kernel & CPU features"

config SMP
    bool "Enabling multi-CPU support"
    help
    	Enabling support for multi-core. Currently used
    	in AVZ configuration mainly, but it could change
    	
config NR_CPUS
	int "Number of supported CPUs"	
	default 1

config CPU_PSCI
	bool "PSCI CPU power management (used in TrustZone)"
	depends on SMP
	default true
	
	help
	  	Enabling PSCI-based CPU power handling. 
	  	It enables/disables secondary CPUs within the Secure mode.
          
config CPU_SPIN_TABLE
	bool "CPU power management following spin table convention."
	depends on SMP && (RPI4 || RPI4_64)
	help
		Enabling CPU power handling based on values stored
		at specific address for each CPU.
		Used by Raspberry Pi 4 for example.

config HZ
	int "System timer event frequency"
	default 100

config SCHED_FLIP_SCHEDFREQ
	int "Scheduler flip frequency"
	default "30"
	help
	  The rate in ms at which the scheduler is invoked.
	  
endmenu

menu "SO3 Scheduling configuration"

choice
	prompt "SO3 Scheduling policy"

	config SCHED_RR
		bool "Sched policy Round-Robin (normal)"
		select SCHED_FREQ_PREEMPTION

    config SCHED_PRIO
		bool "Sched policy with a simple priority based"
	
endchoice

	config SCHED_FREQ_PREEMPTION
		bool "Enabling possible preemption based on a timer frequency"
		
endmenu
```

## so3/mm/Kconfig
```kconfig
config KERNEL_VADDR
	hex "Virtual base address of the hypervisor"
	default 0xff000000 if ARM32
	default 0xffff700000000000 if ARM64 
	default 0x100000000000 if ARM64VT
	
config HEAP_SIZE
	int "Size of the heap in the hypervisor (MB)"
	default 2
```

## so3/so3/devices/Kconfig
```kconfig
menu "Drivers"

config UART
	bool "Driver UART"
	
config IO_MAPPING_BASE
        hex "Virtual I/O Mapping base address"

    
config I2C
	bool "Driver I2C"

config NET
    bool "Network driver"	

config FB
	bool "Framebuffer support (LVGL)"

config INPUT
	bool "Input device support"
	
source "devices/serial/Kconfig"
source "devices/mmc/Kconfig"
source "devices/ramdev/Kconfig"
source "devices/timer/Kconfig"
source "devices/irq/Kconfig"
source "devices/i2c/Kconfig"
source "devices/rpisense/Kconfig"
source "devices/fb/Kconfig"
source "devices/input/Kconfig"
source "devices/net/Kconfig"

endmenu
```

## so3/so3/devices/fb/Kconfig
```kconfig
if FB
config PL111_CLCD
	bool "PL111 CLCD framebuffer device"
	depends on VIRT32 || VIRT64

config QEMU_RAMFB
	bool "QEMU RAMFB Framebuffer device"
	depends on VIRT32 || VIRT64

config SOO_FB
	bool "SOO Virtualized FB device"
	depends on SOO && !AVZ

config VIRTFB
	bool "Virtual Framebuffer"
	help
		Provides a virtual framebuffer device without physical display output.
    		Useful for containerized environments or headless systems.
endif
```

## so3/so3/devices/i2c/Kconfig
```kconfig
config I2C_BSC
    default y
    depends on I2C
	bool "I2C Broadcom Serial Controller (BSC) interface"
	depends on RPI4
```

## so3/so3/devices/input/Kconfig
```kconfig
config PL050_KMI
	bool "PL050 Keyboard/Mouse Interface"
	depends on VIRT32 || VIRT64

config SOO_INPUT
	bool "SOO Virtualized input device"
	depends on SOO && !AVZ

config VIRT_INPUT
	bool "Virtual input device"
	help
		Creates virtual input devices, such as keyboards and mice,  
		to maintain user-space compatibility for applications that  
		require input devices in environments where physical ones
		are unavailable. This allows running an unmodified version  
		of QEMU without requiring special patches for input support.
	depends on VIRT32 || VIRT64
```

## so3/so3/devices/rpisense/Kconfig
```kconfig
config RPI_SENSE
	bool "Driver for the Sense Hat extension board"
	depends on RPI4
	
	
```

## so3/so3/devices/timer/Kconfig
```kconfig
config SP804
	bool "SP804 Timer"
	depends on VIRT32
	
config ARM_TIMER
	bool "ARM architected CP15 timer for clocksource & clockevent"
	depends on !SOO_TIMER

config SOO_TIMER
	bool "SOO Virtualized timer device"
	depends on SOO && !AVZ
```

## so3/so3/fs/Kconfig
```kconfig
menu "Filesystems"

config FS_FAT
        bool "FAT Filesystem"
        depends on MMC || RAMDEV
choice
  prompt "Location of rootfs if any"
	
	config ROOTFS_NONE
    	bool "No Root filesystem"
	
	config ROOTFS_MMC
    	bool "Root filesystem in MMC"
		select MMC
	
	config ROOTFS_RAMDEV
		bool "Root filesystem in RAM (ramdev device)"
		depends on MMU
		select RAMDEV
   
endchoice

endmenu
        
```

## so3/so3/ipc/Kconfig
```kconfig
menu "IPC"

config IPC_SIGNAL
        bool "Signal IPC"

config IPC_PIPE
        bool "Pipe IPC"

endmenu
```

## so3/so3/soo/kernel/debug/Kconfig
```kconfig
menuconfig VIRTSHARE_DEBUG
	default n
	bool "Virtshare debugging tools"

config GPIO_DEBUG
	bool "Low-level GPIO access for debugging purposes"
```

## so3/soo/Kconfig
```kconfig
#
# SOO Mobile Entity configuration
#
if SOO && !AVZ

menu "SOO Mobile Entity - Smart Object Oriented subsystem"

source "soo/me/Kconfig"
source "soo/drivers/Kconfig"

endmenu

endif
```
