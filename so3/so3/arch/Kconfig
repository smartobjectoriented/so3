## so3/so3/arch/Kconfig
```kconfig
choice
	prompt "CPU Architecture"
	
	config ARCH_ARM32
		bool "ARM 32-bit"
		
	config ARCH_ARM64
		bool "ARM 64-bit"

	config ARCH_X86_64
		bool "x86 64-bit"
endchoice

config ARCH
	string "CPU Architecture"
	default "arm32" if ARCH_ARM32
	default "arm64" if ARCH_ARM64
	default "x86" if ARCH_X86_64

config CROSS_COMPILE
	string "Cross-compiler"
	default "arm-none-linux-gnueabihf-" if ARCH_ARM32
	default "aarch64-none-linux-gnu-" if ARCH_ARM64
	default "x86_64-linux-gnu-" if ARCH_X86_64

config ARM_TRUSTZONE
	bool "Using ARM TrustZone with OPTEE-OS"
	depends on !ARCH_X86_64


source "arch/arm32/Kconfig"
source "arch/arm64/Kconfig"
source "arch/x86/Kconfig"


	
```

## so3/so3/arch/x86/Kconfig
```kconfig
if ARCH_X86_64

menu "Platform"

	choice
		prompt "Target"

		config PC64
			bool "Generic QEMU x86_64 PC (i440FX, 8259 PIC, 8254 PIT, COM1)"

	endchoice

endmenu

endif
```

## so3/so3/devices/timer/Kconfig
```kconfig
config SP804
	bool "SP804 Timer"
	depends on VIRT32
	
config ARM_TIMER
	bool "ARM architected CP15 timer for clocksource & clockevent"
	depends on !SOO_TIMER

config SOO_TIMER
	bool "SOO Virtualized timer device"
	depends on SOO && !AVZ

config I8254
	bool "x86 PC timers: 8254 PIT tick and TSC clocksource"
	depends on ARCH_X86_64
```
