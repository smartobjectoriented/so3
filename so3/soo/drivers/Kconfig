## so3/soo/drivers/Kconfig
```kconfig
#
# SOO Mobile Entity configuration
#

menu "SOO Mobile Entity frontend drivers"

config VDUMMY_FRONTEND
        bool "vdummy Dummy driver support debugging and testing"

config VUART_FRONTEND
	bool "vuart serial driver"

config VDOGA12V6NM_FRONTEND
	bool "vDoga12v6nm frontend for the DOGA 12V 6Nm blind motor"

config VWEATHER_FRONTEND
	bool "vWeather frontend for the SOO.outdoor weather station"

config VUIHANDLER_FRONTEND
	bool "vuihandler UI manager driver"

config VSENSELED_FRONTEND
    bool "vsenseled led matrix Sense HAT frontend"

config VSENSEJ_FRONTEND
    bool "vsensej joystick Sense HAT frontend"

config VENOCEAN_FRONTEND
    bool "En0cean frontend"

config VWAGOLED_FRONTEND
    bool "Wagoled frontend"
    
config VIUOC_FRONTEND
    bool "iuoc frontend"

config VKNX_FRONTEND
    bool "KNX frontend"

endmenu
```

## so3/soo/drivers/vnetfront/Kconfig
```kconfig
#
# SOO device configuration
#

menu "vnet frontend"

config VNET_FRONT_DHCP
    bool "Use DHCP"
    depends on VNET_FRONTEND
    help
      The me use DHCP to acquire IP


endmenu
```

## so3/soo/me/Kconfig
```kconfig
choice

	prompt "SOO Mobile Entity environment"
	
	config SOO_REFSO3
		bool "SO3 ME Reference"
		help
			The SO3 ME is a reference mobile entity which is used for debugging and testing purposes.
			It helps in the test & debug of interactions between the Agency and the ME for example.
		
endchoice
```

## so3/target/virt32_lvperf.its
```
/*
 * Copyright (C) 2025 André Costa <andre_miguel_costa@hotmail.com>
 *
 * This program is free software; you can redistribute it and/or modify
 * it under the terms of the GNU General Public License version 2 as
 * published by the Free Software Foundation.
 *
 * This program is distributed in the hope that it will be useful,
 * but WITHOUT ANY WARRANTY; without even the implied warranty of
 * MERCHANTABILITY or FITNESS FOR A PARTICULAR PURPOSE.  See the
 * GNU General Public License for more details.
 *
 * You should have received a copy of the GNU General Public License
 * along with this program; if not, write to the Free Software
 * Foundation, Inc., 51 Franklin St, Fifth Floor, Boston, MA  02110-1301  USA
 *
*/


/dts-v1/;
	
/ {
	description = "Kernel and rootfs components for virt32 environment";

	images {

		so3 {
			description = "SO3 OS kernel";
			data = /incbin/("../so3/so3.bin");
			type = "kernel";
			arch = "arm";
			os = "linux";
			compression = "none";
			load = <0x41008000>;
			entry = <0x41008000>;
		};

		lvperf_fdt {
			description = "Flattened Device Tree blob";
			data = /incbin/("../so3/dts/virt32_lvperf.dtb");
			type = "flat_dt";
			arch = "arm";
			compression = "none";
			load = <0x44a00000>;

		};	

		ramfs {
			description = "SO3 environment minimal rootfs";
			data = /incbin/("../rootfs/rootfs.fat");
			type = "ramdisk";
			arch = "arm";
			os = "linux";
			compression = "none";
			load = <0x44c00000>;
		};


	};
	
	configurations {
		default = "so3_lvperf_ramfs";
		so3_lvperf_ramfs {
			description = "SO3 kernel image including device tree";
			kernel = "so3";
			fdt = "lvperf_fdt";
			ramdisk = "ramfs"; 
		};
	};
};
```

## so3/target/virt64_lvperf.its
```
/*
 * Copyright (C) 2025 André Costa <andre_miguel_costa@hotmail.com>
 *
 * This program is free software; you can redistribute it and/or modify
 * it under the terms of the GNU General Public License version 2 as
 * published by the Free Software Foundation.
 *
 * This program is distributed in the hope that it will be useful,
 * but WITHOUT ANY WARRANTY; without even the implied warranty of
 * MERCHANTABILITY or FITNESS FOR A PARTICULAR PURPOSE.  See the
 * GNU General Public License for more details.
 *
 * You should have received a copy of the GNU General Public License
 * along with this program; if not, write to the Free Software
 * Foundation, Inc., 51 Franklin St, Fifth Floor, Boston, MA  02110-1301  USA
 *
 */

/* Based on virt64_so3_standalone.its */

/dts-v1/;

/ {
	description = "Kernel and rootfs components for virt64 (armv8) environment";

	images {
		so3 {
			description = "SO3 OS kernel";
			data = /incbin/("../so3/so3.bin");
			type = "kernel";
			arch = "arm64";
			os = "linux";
			compression = "none";
			load = <0x41080000>;
			entry = <0x41080000>;
		};

		lvperf_fdt {
			description = "Flattened Device Tree blob";
			data = /incbin/("../so3/dts/virt64_lvperf.dtb");
			type = "flat_dt";
			arch = "arm64";
			compression = "none";
			load = <0x44a00000>;
		};	

		ramfs {
			description = "SO3 environment minimal rootfs";
			data = /incbin/("../rootfs/rootfs.fat");
			type = "ramdisk";
			arch = "arm64";
			os = "linux";
			compression = "none";
			load = <0x44c00000>;
		};
                
	};

	configurations {
		default = "so3_lvperf_ramfs";

		so3_lvperf_ramfs {
			description = "SO3 kernel image for lvgl perfomance tests";
			kernel = "so3";
			fdt = "lvperf_fdt";
			ramdisk = "ramfs";
		};
	};

};
```

## target/agency.its
```
/*
 * Copyright (C) 2018-2019 Daniel Rossier <daniel.rossier@soo.tech>
 *
 * This program is free software; you can redistribute it and/or modify
 * it under the terms of the GNU General Public License version 2 as
 * published by the Free Software Foundation.
 *
 * This program is distributed in the hope that it will be useful,
 * but WITHOUT ANY WARRANTY; without even the implied warranty of
 * MERCHANTABILITY or FITNESS FOR A PARTICULAR PURPOSE.  See the
 * GNU General Public License for more details.
 *
 * You should have received a copy of the GNU General Public License
 * along with this program; if not, write to the Free Software
 * Foundation, Inc., 51 Franklin St, Fifth Floor, Boston, MA  02110-1301  USA
 *
 */

/dts-v1/;

/ {
	description = "SO3 image for the SOO.agency ME";

	images {
	
		so3 {
			description = "SO3 OS kernel";
			data = /incbin/("../so3/so3.bin");
			type = "ME";
			arch = "arm";
			os = "linux";
			compression = "none";
			
			hash {
				algo = "crc32";
			};
		};

		fdt {
			description = "Flattened Device Tree blob";
			data = /incbin/("../so3/dts/agency.dtb");
			type = "flat_dt";
			arch = "arm";
			compression = "none";
			hash {
				algo = "crc32";
			};
		};	

    };
};
```

## target/iuoc_64.its
```
/*
 * Copyright (C) 2023 A.Gabriel Catel Torres <arzur.cateltorres@heig-vd.ch>
 *
 * This program is free software; you can redistribute it and/or modify
 * it under the terms of the GNU General Public License version 2 as
 * published by the Free Software Foundation.
 *
 * This program is distributed in the hope that it will be useful,
 * but WITHOUT ANY WARRANTY; without even the implied warranty of
 * MERCHANTABILITY or FITNESS FOR A PARTICULAR PURPOSE.  See the
 * GNU General Public License for more details.
 *
 * You should have received a copy of the GNU General Public License
 * along with this program; if not, write to the Free Software
 * Foundation, Inc., 51 Franklin St, Fifth Floor, Boston, MA  02110-1301  USA
 *
 */

/dts-v1/;

/ {
	description = "SO3 image for the SOO.iuoc ME";

	images {
	
		so3 {
			description = "SO3 OS kernel";
			data = /incbin/("../so3/so3.bin");
			type = "ME";
			arch = "arm64";
			os = "linux";
			compression = "none";
		};

		fdt {
			description = "Flattened Device Tree blob";
			data = /incbin/("../so3/dts/iuoc.dtb");
			type = "flat_dt";
			arch = "arm64";
			compression = "none";
		};	
    };
};
```

## target/merida.its
```
/*
 * Copyright (C) 2014-2017 Daniel Rossier <daniel.rossier@heig-vd.ch>
 *
 * This program is free software; you can redistribute it and/or modify
 * it under the terms of the GNU General Public License version 2 as
 * published by the Free Software Foundation.
 *
 * This program is distributed in the hope that it will be useful,
 * but WITHOUT ANY WARRANTY; without even the implied warranty of
 * MERCHANTABILITY or FITNESS FOR A PARTICULAR PURPOSE.  See the
 * GNU General Public License for more details.
 *
 * You should have received a copy of the GNU General Public License
 * along with this program; if not, write to the Free Software
 * Foundation, Inc., 51 Franklin St, Fifth Floor, Boston, MA  02110-1301  USA
 *
 */

/dts-v1/;

/ {
	description = "SO3 for MERIDAv2 Board";
	#address-cells = <0>;
	#size-cells = <0>;

	images {
		kernel {
			description = "AllWinner A64 board SO3 kernel";
			data = /incbin/("../../../so3.bin");
			type = "kernel";
			arch = "arm";
			os = "linux";
			
			compression = "none";
			load = <0x40008000>;
			entry = <0x40008000>;
		};
		fdt {
			description = "Flattened Device Tree blob";
			data = /incbin/("../boot/dts/merida.dtb");
			type = "flat_dt";
			arch = "arm";
			compression = "none";
		};
        ramdisk {
            description = "SO3 environment minimal rootfs";
            data = /incbin/("../../../../filesystem/flash");
            type = "ramdisk";
            arch = "arm";
            os = "linux";
            compression = "none";
            load = <0x44000000>;
            entry = <0x44000000>;
        };
	};

	configurations {
		default = "conf";
		conf {
			description = "MERIDAv2 SO3 with FDT blob";
			kernel = "kernel";
			fdt = "fdt";
			ramdisk = "ramdisk";
		};
	};
};
```

## target/rpi4_64_so3_standalone.its
```
/*
 * Copyright (C) 2020 Daniel Rossier <daniel.rossier@heig-vd.ch>
 *
 * This program is free software; you can redistribute it and/or modify
 * it under the terms of the GNU General Public License version 2 as
 * published by the Free Software Foundation.
 *
 * This program is distributed in the hope that it will be useful,
 * but WITHOUT ANY WARRANTY; without even the implied warranty of
 * MERCHANTABILITY or FITNESS FOR A PARTICULAR PURPOSE.  See the
 * GNU General Public License for more details.
 *
 * You should have received a copy of the GNU General Public License
 * along with this program; if not, write to the Free Software
 * Foundation, Inc., 51 Franklin St, Fifth Floor, Boston, MA  02110-1301  USA
 *
 */

/dts-v1/;

/ {
	description = "Kernel and rootfs components for Raspberry Pi 4 (armv8) environment";

	images {

		so3 {
			description = "SO3 OS kernel";
			data = /incbin/("../so3/so3/so3.bin");
			type = "kernel";
			arch = "arm64";
			os = "linux";
			compression = "none";
			load = <0x01080000>;
			entry = <0x01080000>;
		};
                
		fdt {
			description = "Flattened Device Tree blob";
			data = /incbin/("../so3/so3/dts/rpi4_64.dtb");
			type = "flat_dt";
			arch = "arm64";
			compression = "none";
			load = <0x04a00000>;

		};	

        ramfs {
            description = "SO3 environment minimal rootfs";
            data = /incbin/("../rootfs/rootfs.fat");
            type = "ramdisk";
            arch = "arm64";
            os = "linux";
            compression = "none";
            load = <0x04c00000>;
        };
                
	};

	configurations {
		default = "so3";
                
		so3 {
			description = "SO3 on RPi4/64-bit";
		    kernel = "so3";
            fdt = "fdt";
            ramdisk = "ramfs"; 
		};                  
	};

};
```

## target/rpi4_linux_standalone.its
```
/*
 * Copyright (C) 2020 Daniel Rossier <daniel.rossier@heig-vd.ch>
 *
 * This program is free software; you can redistribute it and/or modify
 * it under the terms of the GNU General Public License version 2 as
 * published by the Free Software Foundation.
 *
 * This program is distributed in the hope that it will be useful,
 * but WITHOUT ANY WARRANTY; without even the implied warranty of
 * MERCHANTABILITY or FITNESS FOR A PARTICULAR PURPOSE.  See the
 * GNU General Public License for more details.
 *
 * You should have received a copy of the GNU General Public License
 * along with this program; if not, write to the Free Software
 * Foundation, Inc., 51 Franklin St, Fifth Floor, Boston, MA  02110-1301  USA
 *
 */

/dts-v1/;

/ {
	description = "Kernel and rootfs components for Raspberry Pi 4 environment";

	images {
		
		linux {
			description = "Linux kernel";
			data = /incbin/("../linux/linux/arch/arm/boot/Image");
			type = "kernel";
			arch = "arm";
			os = "linux";
			compression = "none";
			load = <0x01008000>;
			entry = <0x01008000>;
  
		};

        fdt_linux {
			description = "Linux device tree blob";
			data = /incbin/("../linux/linux/arch/arm/boot/dts/bcm2711-rpi-4-b.dtb");
			type = "flat_dt";
			arch = "arm";
			compression = "none";
			load = <0x10a00000>; 
		};
		
		initrd {
			description = "Initial rootfs (initrd)";
			data = /incbin/("../rootfs/board/rpi4/initrd.cpio");
			type = "ramdisk";
			arch = "arm";
			os = "linux";			
			compression = "none";
			load = <0x10c00000>;
		};
	};
	
	configurations {
		default = "conf_linux";

		conf_linux {
			description = "Linux on Raspberry Pi 4";
            kernel = "linux";
            fdt = "fdt_linux";
            ramdisk = "initrd";
		};
		
	};

};
```

## target/rpi4_so3_standalone.its
```
/*
 * Copyright (C) 2020 Daniel Rossier <daniel.rossier@heig-vd.ch>
 *
 * This program is free software; you can redistribute it and/or modify
 * it under the terms of the GNU General Public License version 2 as
 * published by the Free Software Foundation.
 *
 * This program is distributed in the hope that it will be useful,
 * but WITHOUT ANY WARRANTY; without even the implied warranty of
 * MERCHANTABILITY or FITNESS FOR A PARTICULAR PURPOSE.  See the
 * GNU General Public License for more details.
 *
 * You should have received a copy of the GNU General Public License
 * along with this program; if not, write to the Free Software
 * Foundation, Inc., 51 Franklin St, Fifth Floor, Boston, MA  02110-1301  USA
 *
 */

/dts-v1/;

/ {
	description = "Kernel and rootfs components for Raspberry Pi 4 environment";

	images {

		so3 {
			description = "SO3 OS kernel";
			data = /incbin/("../so3/so3.bin");
			type = "kernel";
			arch = "arm";
			os = "linux";
			compression = "none";
			load = <0x00008000>;
			entry = <0x00008000>;
		};
		
		fdt_so3 {
			description = "SO3 device tree blob";
			data = /incbin/("../so3/so3/dts/rpi4.dtb");
			type = "flat_dt";
			arch = "arm";
			compression = "none";
			load = <0x04a00000>;
		};
		
		ramfs {
			description = "Initial SO3 rootfs (ramfs)";
			data = /incbin/("../rootfs/rootfs.fat");
			type = "ramdisk";
			arch = "arm";
			os = "linux";			
			compression = "none";
			load = <0x04c00000>; 
			
		};
	};
	
	configurations {
		default = "conf_so3";

		conf_so3 {
			description = "SO3 on Raspberry Pi 4";
            kernel = "so3";
            fdt = "fdt_so3";
            ramdisk = "ramfs";
		};
	};

};
```
