## target/vexpress.its
```
/*
 * Copyright (C) 2014-2021 Daniel Rossier <daniel.rossier@heig-vd.ch>
 *
 * This program is free software; you can redistribute it and/or modify
 * it under the terms of the GNU General Public License version 2 as
 * published by the Free Software Foundation.
 *
 * This program is distributed in the hope that it will be useful,
 * but WITHOUT ANY WARRANTY; without even the implied warranty of
 * MERCHANTABILITY or FITNESS FOR A PARTICULAR PURPOSE.  See the
 * GNU General Public License for more details.
 *
 * You should have received a copy of the GNU General Public License
 * along with this program; if not, write to the Free Software
 * Foundation, Inc., 51 Franklin St, Fifth Floor, Boston, MA  02110-1301  USA
 *
 */

/dts-v1/;

/ {
	description = "Kernel and rootfs components for vExpress environment";

	images {

		so3 {
			description = "SO3 OS kernel";
			data = /incbin/("../so3/so3.bin");
			type = "kernel";
			arch = "arm";
			os = "linux";
			compression = "none";
			load = <0x80008000>;
			entry = <0x80008000>;
		};
                
		fdt {
			description = "Flattened Device Tree blob";
			data = /incbin/("../so3/dts/vexpress.dtb");
			type = "flat_dt";
			arch = "arm";
			compression = "none";
			load = <0x84a00000>;

		};	

                ramdisk {
                        description = "SO3 environment minimal rootfs";
                        data = /incbin/("../rootfs/board/vexpress/rootfs.fat");
                        type = "ramdisk";
                        arch = "arm";
                        os = "linux";
                        compression = "none";
                        load = <0x84c00000>;
                };


    };
	configurations {
		default = "so3_ramfs";
                
		so3_ramfs {
			description = "SO3 kernel image including device tree";
			kernel = "so3";
			fdt = "fdt";
                        ramdisk = "ramdisk"; 
		};
                
                so3_mmc {
			description = "SO3 kernel image including device tree";
			kernel = "so3";
			fdt = "fdt";
		};
	};
};
```

## target/virt-riscv64.its
```
/dts-v1/;

/ {
	description = "Kernel and rootfs components for virt-risc-v 64 bits environment";

	images {

		so3 {
			description = "SO3 OS kernel";
			data = /incbin/("../so3/so3.bin");
			type = "kernel";
			arch = "riscv";
			os = "linux";
			compression = "none";
			load = <0x80008000>;
			entry = <0x80008000>;

			hash {
				algo = "crc32";
			};
		};

		fdt {
			description = "Flattened Device Tree blob";
			data = /incbin/("../so3/dts/virt-riscv64.dtb");
			type = "flat_dt";
			arch = "riscv";
			compression = "none";
			load = <0x84a00000>;

			hash {
				algo = "crc32";
			};
		};

        ramdisk {
                description = "SO3 environment minimal rootfs";
                data = /incbin/("../rootfs/board/virt-riscv64/rootfs.fat");
                type = "ramdisk";
                arch = "riscv";
                os = "linux";
                compression = "none";
                load = <0x84c00000>;
        };


    };
	configurations {
		default = "so3_ramfs";

		so3_ramfs {
			description = "SO3 kernel image including device tree";
			kernel = "so3";
			fdt = "fdt";
            ramdisk = "ramdisk";
		};

        so3_mmc {
			description = "SO3 kernel image including device tree";
			kernel = "so3";
			fdt = "fdt";
		};
	};
};
```

## target/virt32_avz.its
```
/*
 * Copyright (C) 2014-2023 Daniel Rossier <daniel.rossier@heig-vd.ch>
 *
 * This program is free software; you can redistribute it and/or modify
 * it under the terms of the GNU General Public License version 2 as
 * published by the Free Software Foundation.
 *
 * This program is distributed in the hope that it will be useful,
 * but WITHOUT ANY WARRANTY; without even the implied warranty of
 * MERCHANTABILITY or FITNESS FOR A PARTICULAR PURPOSE.  See the
 * GNU General Public License for more details.
 *
 * You should have received a copy of the GNU General Public License
 * along with this program; if not, write to the Free Software
 * Foundation, Inc., 51 Franklin St, Fifth Floor, Boston, MA  02110-1301  USA
 *
 */

/dts-v1/;

/ {
	description = "Kernel and rootfs components for virt32 environment";

	images {

		avz {
			description = "AVZ Hypervisor (32-bit) Polymorphic SO3";
            data = /incbin/("../avz/so3.bin");
			type = "kernel";
            os = "linux";
			arch = "arm";
			compression = "none";
			load = <0x40008000>;
			entry = <0x40008000>;
		};

		avz_dt {
			description = "Flattened Device Tree blob";
			data = /incbin/("../avz/dts/virt32_avz.dtb");
			type = "avz_dt";
			arch = "arm";
			compression = "none";
			load = <0x40f00000>;
		};
		
		so3 {
			description = "SO3 OS kernel";
			data = /incbin/("../so3/so3.bin");
			type = "avz";
			arch = "arm";
			os = "linux";
			compression = "none";
			load = <0x41008000>;
			entry = <0x41008000>;
		};
                
		fdt_so3 {
			description = "Flattened Device Tree blob";
			data = /incbin/("../so3/dts/virt32.dtb");
			type = "flat_dt";
			arch = "arm";
			compression = "none";
			load = <0x54a00000>;

		};	

        ramfs {
        	description = "SO3 environment minimal rootfs";
            data = /incbin/("../rootfs/board/virt32/rootfs.fat");
            type = "ramdisk";
            arch = "arm";
            os = "linux";
            compression = "none";
            load = <0x54c00000>;
        };

	};
	
	configurations {
			default = "conf_so3_avz";

			conf_so3_avz {
				description = "SO3/AVZ on virt32";
				kernel = "avz";
				fdt = "fdt_so3";
            	loadables = "avz_dt", "so3";
				ramdisk = "ramfs";
			};
		
	};

};
```

## target/virt32_linux_standalone.its
```
/*
 * Copyright (C) 2014-2023 Daniel Rossier <daniel.rossier@heig-vd.ch>
 *
 * This program is free software; you can redistribute it and/or modify
 * it under the terms of the GNU General Public License version 2 as
 * published by the Free Software Foundation.
 *
 * This program is distributed in the hope that it will be useful,
 * but WITHOUT ANY WARRANTY; without even the implied warranty of
 * MERCHANTABILITY or FITNESS FOR A PARTICULAR PURPOSE.  See the
 * GNU General Public License for more details.
 *
 * You should have received a copy of the GNU General Public License
 * along with this program; if not, write to the Free Software
 * Foundation, Inc., 51 Franklin St, Fifth Floor, Boston, MA  02110-1301  USA
 *
 */

/dts-v1/;

/ {
	description = "Kernel and rootfs components for virt32 environment";

	images {

		linux {
			description = "Linux kernel";
			data = /incbin/("../linux/linux/arch/arm/boot/Image");
			/* type = "avz" */
			type = "kernel";
			arch = "arm";
			os = "linux";
			compression = "none";
			load = <0x41008000>;
			entry = <0x41008000>;
		};

		fdt_linux {
			description = "Linux device tree blob";
			data = /incbin/("../linux/linux/arch/arm/boot/dts/virt32.dtb");
			type = "flat_dt";
			arch = "arm";
			compression = "none";
			load = <0x5a000000>;
		};

		initrd {
			description = "Initial rootfs (initrd)";
			data = /incbin/("../rootfs/board/virt32/initrd.cpio");
			type = "ramdisk";
			arch = "arm";
			os = "linux";
			compression = "none";
			load = <0x50c00000>;
		};

    };
	configurations {
		default = "linux";
                
		linux {
			description = "SO3 kernel image including device tree";
			kernel = "linux";
			fdt = "fdt_linux";
			ramdisk = "initrd";
		};
	};
};
```

## target/virt64_avz.its
```
/*
 * Copyright (C) 2020 Daniel Rossier <daniel.rossier@heig-vd.ch>
 *
 * This program is free software; you can redistribute it and/or modify
 * it under the terms of the GNU General Public License version 2 as
 * published by the Free Software Foundation.
 *
 * This program is distributed in the hope that it will be useful,
 * but WITHOUT ANY WARRANTY; without even the implied warranty of
 * MERCHANTABILITY or FITNESS FOR A PARTICULAR PURPOSE.  See the
 * GNU General Public License for more details.
 *
 * You should have received a copy of the GNU General Public License
 * along with this program; if not, write to the Free Software
 * Foundation, Inc., 51 Franklin St, Fifth Floor, Boston, MA  02110-1301  USA
 *
 */

/dts-v1/;

/ {
	description = "Kernel and rootfs components for virt64 (armv8) environment";

	images {

		avz {
			description = "AVZ Hypervisor (64-bit) Polymorphic SO3";
            data = /incbin/("../avz/so3.bin");
			type = "kernel";
            os = "linux";
			arch = "arm64";
			compression = "none";
			load = <0x40000000>;
			entry = <0x40000000>;
		};
		
		avz_pv_dt {
			description = "Flattened Device Tree blob";
			data = /incbin/("../avz/dts/virt64_avz_vt.dtb");
			type = "avz_dt";
			arch = "arm64";
			compression = "none";
			load = <0x40f00000>;
		};
		
		avz_vt_dt {
			description = "Flattened Device Tree blob";
			data = /incbin/("../avz/dts/virt64_avz_vt.dtb");
			type = "avz_dt";
			arch = "arm64";
			compression = "none";
			load = <0x40f00000>;
		};
		
		so3_agency {
			description = "SO3 OS kernel";
			data = /incbin/("../so3/so3.bin");
			type = "avz";
			arch = "arm64";
			os = "linux";
			compression = "none";
            load = <0x41000000>;
			entry = <0x41000000>;
		};
 
        fdt_so3 {
			description = "Flattened Device Tree blob";
			data = /incbin/("../so3/dts/virt64.dtb");
			type = "flat_dt";
			arch = "arm64";
			compression = "none";
			load = <0x42000000>;
		};	
        
        ramfs {
        	description = "SO3 environment minimal rootfs";
			data = /incbin/("../rootfs/board/virt64/rootfs.fat");
			type = "ramdisk";
			arch = "arm64";
			os = "linux";
			compression = "none";
			load = <0x42c00000>;
    	};
                
};

	configurations {
		default = "so3_avz";
                
		so3_avz {
			description = "SO3/AVZ on virt64";
		    kernel = "avz";
            loadables = "avz_vt_dt", "so3_agency"; 
            fdt = "fdt_so3";
            ramdisk = "ramfs"; 
		};
                
	};

};
```

## u-boot/board/armltd/vexpress/Kconfig
```kconfig
if ARCH_VEXPRESS

config SYS_BOARD
	default "vexpress"

config SYS_VENDOR
	default "armltd"

config SYS_CONFIG_NAME
	default "vexpress"

config VEXPRESS_EXTENDED_MEMORY_MAP
	bool
	default n

choice
        prompt "Arm VExpress coretile"

config TARGET_VEXPRESS_CA15_TC2
	bool "Arm Versatile Express TC2 (Cortex-A15/A7)"
	select CPU_V7_HAS_NONSEC
	select CPU_V7_HAS_VIRT
	select VEXPRESS_EXTENDED_MEMORY_MAP
	select OF_BOARD_SETUP

config TARGET_VEXPRESS_CA5X2
	bool "Arm Versatile Express Cortex-A5x2"
	select VEXPRESS_EXTENDED_MEMORY_MAP

config TARGET_VEXPRESS_CA9X4
	bool "Arm Versatile Express Cortex-A9x4"

endchoice

config SYS_TEXT_BASE
	default 0x80800000 if VEXPRESS_EXTENDED_MEMORY_MAP
	default 0x60800000

endif
```

## u-boot/configs/vexpress_ca15_tc2_defconfig
```kconfig
CONFIG_ARM=y
CONFIG_ARCH_VEXPRESS=y
CONFIG_DEFAULT_DEVICE_TREE="vexpress-v2p-ca15_a7"
CONFIG_TARGET_VEXPRESS_CA15_TC2=y
CONFIG_BOOTCOMMAND="run distro_bootcmd; run bootflash"
# CONFIG_DISPLAY_CPUINFO is not set
CONFIG_CMD_UBI=y
CONFIG_ENV_OVERWRITE=y
CONFIG_ENV_ADDR=0xFF80000
# CONFIG_MMC is not set
CONFIG_SYS_FLASH_USE_BUFFER_WRITE=y
CONFIG_SYS_FLASH_PROTECTION=y
CONFIG_SYS_FLASH_CFI=y
CONFIG_SMC911X=y
CONFIG_BAUDRATE=38400
# CONFIG_EFI_LOADER is not set
```

## u-boot/configs/vexpress_ca5x2_defconfig
```kconfig
CONFIG_ARM=y
CONFIG_ARCH_VEXPRESS=y
CONFIG_DEFAULT_DEVICE_TREE="vexpress-v2p-ca5s"
CONFIG_TARGET_VEXPRESS_CA5X2=y
CONFIG_BOOTCOMMAND="run distro_bootcmd; run bootflash"
# CONFIG_DISPLAY_CPUINFO is not set
CONFIG_CMD_UBI=y
CONFIG_ENV_OVERWRITE=y
CONFIG_ENV_ADDR=0xFF80000
# CONFIG_MMC is not set
CONFIG_SYS_FLASH_USE_BUFFER_WRITE=y
CONFIG_SYS_FLASH_PROTECTION=y
CONFIG_SYS_FLASH_CFI=y
CONFIG_SMC911X=y
CONFIG_BAUDRATE=38400
```
