## build/conf/bblayers.conf
```bitbake
# All layers managed by Infrabase

BBPATH := "${TOPDIR}"
BBFILES ?= ""
BBLAYERS = " \
  ${TOPDIR}/meta \
  ${TOPDIR}/meta-qemu \
  ${TOPDIR}/meta-filesystem \
  ${TOPDIR}/meta-uboot \
  ${TOPDIR}/meta-linux \
  ${TOPDIR}/meta-rootfs \
  ${TOPDIR}/meta-usr \
  ${TOPDIR}/meta-bsp \
  ${TOPDIR}/meta-so3 \
  ${TOPDIR}/meta-atf \
  "
```

## build/meta-atf/conf/layer.conf
```bitbake
BBPATH .= ":${LAYERDIR}"
BBFILES += "${LAYERDIR}/recipes-*/*/*.bb ${LAYERDIR}/recipes-*/*/*.bbappend"

# append layer name to list of configured layers
BBFILE_COLLECTIONS += "atf"

LAYERSERIES_COMPAT_atf = "infrabase_core"
LAYERDEPENDS_atf = "core"

# and use name as suffix for other properties
BBFILE_PATTERN_atf = "^${LAYERDIR}/"
BBFILE_PRIORITY_atf = "4"
```

## build/meta-bsp/conf/layer.conf
```bitbake
BBPATH .= ":${LAYERDIR}"
BBFILES += "${LAYERDIR}/recipes-*/*/*.bb ${LAYERDIR}/recipes-*/*/*.bbappend"

# append layer name to list of configured layers
BBFILE_COLLECTIONS += "bsp"

LAYERSERIES_COMPAT_bsp = "infrabase_core"
LAYERDEPENDS_bsp = "core"

# and use name as suffix for other properties
BBFILE_PATTERN_bsp = "^${LAYERDIR}/"
BBFILE_PRIORITY_bsp = "4"
```

## build/meta-filesystem/conf/layer.conf
```bitbake
BBPATH .= ":${LAYERDIR}"
BBFILES += "${LAYERDIR}/recipes-*/*/*.bb ${LAYERDIR}/recipes-*/*/*.bbappend"

# append layer name to list of configured layers
BBFILE_COLLECTIONS += "filesystem"

LAYERSERIES_COMPAT_filesystem = "infrabase_core"
LAYERDEPENDS_filesystem = "core"

# and use name as suffix for other properties
BBFILE_PATTERN_filesystem = "^${LAYERDIR}/"
BBFILE_PRIORITY_filesystem = "4"
```

## build/meta-linux/conf/layer.conf
```bitbake
BBPATH .= ":${LAYERDIR}"
BBFILES += "${LAYERDIR}/recipes-*/*/*.bb ${LAYERDIR}/recipes-*/*/*.bbappend"

# append layer name to list of configured layers
BBFILE_COLLECTIONS += "linux"

LAYERSERIES_COMPAT_linux = "infrabase_core"
LAYERDEPENDS_linux = "core"

# and use name as suffix for other properties
BBFILE_PATTERN_linux = "^${LAYERDIR}/recipes-*/*"
BBFILE_PRIORITY_linux = "4"
```

## build/meta-qemu/conf/layer.conf
```bitbake
BBPATH .= ":${LAYERDIR}"
BBFILES += "${LAYERDIR}/recipes-*/*/*.bb ${LAYERDIR}/recipes-*/*/*.bbappend"

# append layer name to list of configured layers
BBFILE_COLLECTIONS += "qemu"

LAYERSERIES_COMPAT_qemu = "infrabase_core"
LAYERDEPENDS_qemu = "core"

# and use name as suffix for other properties
BBFILE_PATTERN_qemu = "^${LAYERDIR}/"
BBFILE_PRIORITY_qemu = "4"
```

## build/meta-rootfs/conf/layer.conf
```bitbake
BBPATH .= ":${LAYERDIR}"
BBFILES += "${LAYERDIR}/recipes-*/*/*.bb ${LAYERDIR}/recipes-*/*/*.bbappend"

# append layer name to list of configured layers
BBFILE_COLLECTIONS += "rootfs"

LAYERSERIES_COMPAT_rootfs = "infrabase_core"
LAYERDEPENDS_rootfs = "core"

# and use name as suffix for other properties
BBFILE_PATTERN_rootfs = "^${LAYERDIR}/"
BBFILE_PRIORITY_rootfs = "4"  
```

## build/meta-so3/conf/layer.conf
```bitbake
BBPATH .= ":${LAYERDIR}"
BBFILES += "${LAYERDIR}/recipes-*/*/*.bb ${LAYERDIR}/recipes-*/*/*.bbappend"

# append layer name to list of configured layers
BBFILE_COLLECTIONS += "so3"

LAYERSERIES_COMPAT_so3 = "infrabase_core"
LAYERDEPENDS_so3 = "so3"

# and use name as suffix for other properties
BBFILE_PATTERN_so3 = "^${LAYERDIR}/"
BBFILE_PRIORITY_so3 = "4"
```

## build/meta-uboot/conf/layer.conf
```bitbake
BBPATH .= ":${LAYERDIR}"
BBFILES += "${LAYERDIR}/recipes-*/*/*.bb ${LAYERDIR}/recipes-*/*/*.bbappend"

# append layer name to list of configured layers
BBFILE_COLLECTIONS += "uboot"

LAYERSERIES_COMPAT_uboot = "infrabase_core"
LAYERDEPENDS_uboot = "core"

# and use name as suffix for other properties
BBFILE_PATTERN_uboot = "^${LAYERDIR}/"
BBFILE_PRIORITY_uboot = "4"
```

## build/meta-usr/conf/layer.conf
```bitbake
BBPATH .= ":${LAYERDIR}"
BBFILES += "${LAYERDIR}/recipes-*/*/*.bb ${LAYERDIR}/recipes-*/*/*.bbappend"

# append layer name to list of configured layers
BBFILE_COLLECTIONS += "usr"

LAYERSERIES_COMPAT_usr = "infrabase_core"
LAYERDEPENDS_usr = "usr"

# and use name as suffix for other properties
BBFILE_PATTERN_usr = "^${LAYERDIR}/"
BBFILE_PRIORITY_usr = "4"

# Path to the usr contents that need to be deployed
# into the rootfs

IB_USR_PATH:so3 = "${IB_DIR}/so3/usr"
IB_USR_PATH:linux = "${IB_DIR}/linux/usr"
```

## build/meta/conf/layer.conf
```bitbake
BBPATH .= ":${LAYERDIR}"
BBFILES += "${LAYERDIR}/recipes-*/*/*.bb"

# append layer name to list of configured layers
BBFILE_COLLECTIONS += "core"

# and use name as suffix for other properties
BBFILE_PATTERN_core = "^${LAYERDIR}/"
BBFILE_PRIORITY_core = "5"

LAYERSERIES_CORENAMES = "infrabase_core"

# This should only be incremented on significant changes that will
# cause compatibility issues with other layers
LAYERVERSION_core = "1"
LAYERSERIES_COMPAT_core = "infrabase_core"
```

## ci/so3/arch/arm64/rpi4_64/Kconfig
```kconfig
config RAM_BASE
	depends on RPI4_64
	hex "RAM Memory physical base address"
	default 0x00000000
```

## ci/so3/devices/fb/Kconfig
```kconfig
config PL111_CLCD
	bool "PL111 CLCD framebuffer device"
	depends on VEXPRESS || VIRT64
```

## ci/so3/devices/net/Kconfig
```kconfig
config SMC911X
	bool "smc911x network interface"
	depends on VEXPRESS
	depends on NET

	
	
```

## so3/Kconfig
```kconfig
mainmenu "SO3 Polymorphic OS Configuration"
 
source "arch/Kconfig"

source "kernel/Kconfig"
 
source "devices/Kconfig" 

source "apps/Kconfig"

source "fs/Kconfig"
source "ipc/Kconfig"
source "mm/Kconfig"
 
config RTOS
	bool "RTOS-featured enabled"
 
config AVZ
	bool "AVZ SO3 Hypervisor mode (Agency Virtualizer)"
	depends on MMU

config MMU
	bool "MMU enable"
	
config DEBUG_PRINTK
	bool "Debug printk"
```

## so3/apps/Kconfig
```kconfig
menu "SO3 Applications"

	config APP_SAMPLE
		bool "Sample application with thread environment"
	
endmenu
```

## so3/arch/Kconfig
```kconfig
choice
	prompt "CPU Architecture"
	
	config ARCH_ARM32
		bool "ARM 32-bit"
		
	config ARCH_ARM64
		bool "ARM 64-bit"
endchoice

config SO3VIRT
		bool "SO3 Paravirtualized OS (running on AVZ)"
		depends on MMU && !AVZ

config ARCH
	string "ARM Architecture"
	default "arm32" if ARCH_ARM32
	default "arm64" if ARCH_ARM64

config CROSS_COMPILE
	string "Cross-compiler"
	default "arm-none-linux-gnueabihf-" if ARCH_ARM32
	default "aarch64-none-linux-gnu-" if ARCH_ARM64

config ARM_TRUSTZONE
	bool "Using ARM TrustZone with OPTEE-OS"


source "arch/arm32/Kconfig"
source "arch/arm64/Kconfig"


	
```

## so3/arch/arm/Kconfig
```kconfig
menu "Platform"

choice
	prompt "SO3 OS type"

config STANDALONE
        bool "Standalone OS"
        
endchoice

choice
  prompt "Target"
	
	config VEXPRESS
    		bool "Vexpress"
        config RPI4
        	bool "Raspberry Pi 4 B"
        
   
endchoice

source "arch/arm/vexpress/Kconfig"
source "arch/arm/merida/Kconfig"
source "arch/arm/bpi/Kconfig"
source "arch/arm/rpi4/Kconfig"
endmenu
```

## so3/arch/arm/bpi/Kconfig
```kconfig
config RAM_BASE
	depends on BPI
	hex "RAM Memory physical base address"
	default 0x44000000
```

## so3/arch/arm/vexpress/Kconfig
```kconfig
config RAM_BASE
	depends on VEXPRESS
	hex "RAM Memory physical base address"
	default 0x80000000
```

## so3/arch/arm/vexpress/vexpress_simple.its
```
/*
 * Copyright (C) 2014-2017 Daniel Rossier <daniel.rossier@heig-vd.ch>
 *
 * This program is free software; you can redistribute it and/or modify
 * it under the terms of the GNU General Public License version 2 as
 * published by the Free Software Foundation.
 *
 * This program is distributed in the hope that it will be useful,
 * but WITHOUT ANY WARRANTY; without even the implied warranty of
 * MERCHANTABILITY or FITNESS FOR A PARTICULAR PURPOSE.  See the
 * GNU General Public License for more details.
 *
 * You should have received a copy of the GNU General Public License
 * along with this program; if not, write to the Free Software
 * Foundation, Inc., 51 Franklin St, Fifth Floor, Boston, MA  02110-1301  USA
 *
 */

/dts-v1/;

/ {
	description = "SO3 image containing so3 kernel and FDT blob";
	#address-cells = <0>;
	#size-cells = <0>;
	
	images {
		#address-cells = <0>;
		#size-cells = <0>;
		kernel {
			/*reg = <>; Make dtc happy ;-) */
			description = "SO3 OS kernel";
			data = /incbin/("../../../so3.bin");
			type = "kernel";
			arch = "arm";
			os = "linux";
			compression = "none";
			load = <0x80008000>;
			entry = <0x80008000>;
			
			#address-cells = <0>;
			#size-cells = <0>;
			
			hash {
				algo = "crc32";
			};
		};
		fdt {
			description = "Flattened Device Tree blob";
			data = /incbin/("../boot/dts/vexpress.dtb");
			type = "flat_dt";
			arch = "arm";
			compression = "none";
			hash {
				algo = "crc32";
			};
		};	

    };
	configurations {
		default = "conf";
		conf {
			description = "SO3 kernel image including device tree";
			kernel = "kernel";
			fdt = "fdt";
		    ramdisk = "ramdisk";
		};
	};
};
```
