## build/meta-bsp/recipes-bsp/linux/files/its/rpi4_64.its
```
/*
 * Copyright (C) 2020-2026 EDGEMTech SA <info@edgemtech.ch>
 *
 * Bare bsp-linux ITS for the Raspberry Pi 4 (64-bit). Standalone Linux
 * booted by U-Boot's bootm from a single ITB (no ATF, no AVZ). Pairs
 * with IB_TARGET_ITS:linux:rpi4_64="rpi4_64".
 *
 * Kernel + DTB: the raspberrypi/linux build (arch/arm64/boot/Image and
 * the real board DTB bcm2711-rpi-4-b.dtb — Linux drives the full Pi
 * hardware here, unlike the minimal SO3 rpi4_64.dts).
 * Initrd: linux/rootfs's board/rpi4_64 buildroot output, gzipped at
 * deploy time into initrd.cpio.gz (root=/dev/ram).
 *
 * Template: ${IB_*_PATH} / ${IB_PLATFORM} placeholders are expanded to
 * absolute build paths by bsp_render_its (bsp.bbclass) at do_itb time.
 *
 * The AVZ two-ITB path uses rpi4_64_avz.its + the guest ITB instead
 * (rpi4_64_linux_guest.its for the Linux agency) — see those files.
 *
 * This program is free software; you can redistribute it and/or modify
 * it under the terms of the GNU General Public License version 2 as
 * published by the Free Software Foundation.
 *
 * This program is distributed in the hope that it will be useful,
 * but WITHOUT ANY WARRANTY; without even the implied warranty of
 * MERCHANTABILITY or FITNESS FOR A PARTICULAR PURPOSE.  See the
 * GNU General Public License for more details.
 *
 * You should have received a copy of the GNU General Public License
 * along with this program; if not, write to the Free Software
 * Foundation, Inc., 51 Franklin St, Fifth Floor, Boston, MA  02110-1301  USA
 *
 */

/dts-v1/;

/ {
	description = "Kernel and rootfs components for Raspberry Pi 4 (64-bit) environment";

	images {

		linux {
			description = "Linux kernel";
			data = /incbin/("${IB_LINUX_PATH}/arch/arm64/boot/Image");
			type = "kernel";
			arch = "arm64";
			os = "linux";
			compression = "none";
			load = <0x01000000>;
			entry = <0x01000000>;
		};

		fdt_linux {
			description = "Linux device tree blob";
			data = /incbin/("${IB_LINUX_PATH}/arch/arm64/boot/dts/broadcom/bcm2711-rpi-4-b.dtb");
			type = "flat_dt";
			arch = "arm64";
			compression = "none";
			load = <0x10a00000>;
		};

		initrd {
			description = "Initial rootfs (initrd)";
			data = /incbin/("${IB_ROOTFS_PATH}/board/${IB_PLATFORM}/initrd.cpio.gz");
			type = "ramdisk";
			arch = "arm64";
			os = "linux";
			compression = "gzip";
			load = <0x10c00000>;
		};
	};

	configurations {
		default = "conf_linux";

		conf_linux {
			description = "Linux on Raspberry Pi 4 (64-bit)";
			kernel = "linux";
			fdt = "fdt_linux";
			ramdisk = "initrd";
		};
	};

};
```

## build/meta-bsp/recipes-bsp/linux/files/its/rpi4_64_avz.its
```
/*
 * Copyright (C) 2020-2026 Daniel Rossier <daniel.rossier@heig-vd.ch>
 *
 * AVZ ITB for RPi4 (64-bit). Carries only the AVZ hypervisor binary
 * (so3.bin) + the AVZ device tree. The guest (SO3) lives in a SEPARATE
 * ITB (rpi4_64_so3_guest.its); both are loaded by U-Boot's guest-boot
 * command, which passes the AVZ FIT in x0 and the guest ITB in x1.
 *
 * This program is free software; you can redistribute it and/or modify
 * it under the terms of the GNU General Public License version 2 as
 * published by the Free Software Foundation.
 *
 */

/dts-v1/;

/ {
	description = "AVZ Hypervisor bundle for RPi4 (64-bit)";

	images {

		avz {
			description = "AVZ Hypervisor (64-bit) Polymorphic SO3";
			data = /incbin/("${IB_AVZ_PATH}/so3.bin");
			type = "kernel";
			os = "linux";
			arch = "arm64";
			compression = "none";
			load = <0x00080000>;
			entry = <0x00080000>;
		};

		avz_dt {
			description = "AVZ device tree";
			data = /incbin/("${IB_AVZ_PATH}/dts/rpi4_64_avz.dtb");
			type = "avz_dt";
			arch = "arm64";
			compression = "none";
			load = <0x03000000>;
		};
	};

	configurations {
		default = "avz";

		avz {
			description = "AVZ hypervisor on RPi4 64-bit";
			kernel = "avz";
			loadables = "avz_dt";
			fdt = "avz_dt";
		};
	};
};
```

## build/meta-bsp/recipes-bsp/linux/files/its/virt32.its
```
/*
 * Copyright (C) 2014-2026 Daniel Rossier <daniel.rossier@heig-vd.ch>
 *
 * This program is free software; you can redistribute it and/or modify
 * it under the terms of the GNU General Public License version 2 as
 * published by the Free Software Foundation.
 *
 * This program is distributed in the hope that it will be useful,
 * but WITHOUT ANY WARRANTY; without even the implied warranty of
 * MERCHANTABILITY or FITNESS FOR A PARTICULAR PURPOSE.  See the
 * GNU General Public License for more details.
 *
 * You should have received a copy of the GNU General Public License
 * along with this program; if not, write to the Free Software
 * Foundation, Inc., 51 Franklin St, Fifth Floor, Boston, MA  02110-1301  USA
 *
 * Standalone Linux on the virt32 (armv7) QEMU machine, the 32-bit twin of
 * virt64.its. This file used to be a third copy of the Linux-on-AVZ ITS
 * (virt32_avz.its, which remains the AVZ flavour); the naming now matches
 * the virt64 pair: <plat>.its = standalone Linux, <plat>_avz.its = on AVZ.
 */

/dts-v1/;

/ {
	description = "Kernel and rootfs components for virt32 (armv7) environment";

	images {

		linux {
			description = "Linux kernel";
			data = /incbin/("${IB_LINUX_PATH}/arch/arm/boot/Image");
			type = "kernel";
			arch = "arm";
			os = "linux";
			compression = "none";

			/*
			 * RAM base 0x40000000 + the arm32 0x8000 text offset: a raw
			 * (uncompressed) 32-bit Image is not relocatable — unlike the
			 * arm64 Image, whose header lets U-Boot place it, and unlike a
			 * zImage. Loading it anywhere else hangs right after
			 * "Starting kernel ...".
			 */
			load = <0x40008000>;
			entry = <0x40008000>;
		};

		fdt_linux {
			description = "Linux device tree blob";
			data = /incbin/("${IB_LINUX_PATH}/arch/arm/boot/dts/arm/${IB_PLATFORM}.dtb");
			type = "flat_dt";
			arch = "arm";
			compression = "none";
			load = <0x50000000>;
		};

		initrd {
			description = "Initial rootfs (initrd)";
			data = /incbin/("${IB_ROOTFS_PATH}/board/${IB_PLATFORM}/initrd.cpio.gz");
			type = "ramdisk";
			arch = "arm";
			os = "linux";
			/*
			 * "none": U-Boot never decompresses ramdisks (the kernel
			 * unpacks the gzip'd initramfs itself), and declaring a
			 * compression here is deprecated — it only earns a WARNING
			 * at boot.
			 */
			compression = "none";
			load = <0x50c00000>;
		};

	};

	configurations {
		default = "conf_linux";

		conf_linux {
			description = "Linux on virt32";
			kernel = "linux";
			fdt = "fdt_linux";
			ramdisk = "initrd";
		};
	};
};
```

## build/meta-bsp/recipes-bsp/linux/files/its/virt32_standalone.its
```
/*
 * Copyright (C) 2014-2023 Daniel Rossier <daniel.rossier@heig-vd.ch>
 *
 * This program is free software; you can redistribute it and/or modify
 * it under the terms of the GNU General Public License version 2 as
 * published by the Free Software Foundation.
 *
 * This program is distributed in the hope that it will be useful,
 * but WITHOUT ANY WARRANTY; without even the implied warranty of
 * MERCHANTABILITY or FITNESS FOR A PARTICULAR PURPOSE.  See the
 * GNU General Public License for more details.
 *
 * You should have received a copy of the GNU General Public License
 * along with this program; if not, write to the Free Software
 * Foundation, Inc., 51 Franklin St, Fifth Floor, Boston, MA  02110-1301  USA
 *
 */

/dts-v1/;

/ {
	description = "Kernel and rootfs components for virt32 environment";

	images {

/*
		avz {
			description = "AVZ Hypervisor (32-bit) Polymorphic SO3";
            data = /incbin/("${IB_AVZ_PATH}/so3.bin");
			type = "kernel";
            os = "linux";
			arch = "arm";
			compression = "none";
			load = <0x40008000>;
			entry = <0x40008000>;
		};

		avz_dt {
			description = "Flattened Device Tree blob";
			data = /incbin/("${IB_AVZ_PATH}/dts/virt32_avz.dtb");
			type = "avz_dt";
			arch = "arm";
			compression = "none";
			load = <0x40f00000>;
		};
		
*/
		linux {
			description = "Linux kernel";
			data = /incbin/("${IB_LINUX_PATH}/linux/arch/arm/boot/Image");
			/* type = "avz" */
			type = "kernel";
			arch = "arm";
			os = "linux";
			compression = "none";
			load = <0x41008000>;
			entry = <0x41008000>;
		};
		 
		fdt_linux {
			description = "Linux device tree blob";
			data = /incbin/("${IB_LINUX_PATH}/linux/arch/arm/boot/dts/virt32.dtb");
			type = "flat_dt";
			arch = "arm";
			compression = "none";
			load = <0x5a000000>;
		};

		initrd {
			description = "Initial rootfs (initrd)";
			data = /incbin/("${IB_ROOTFS_PATH}/board/virt32/initrd.cpio.gz");
			type = "ramdisk";
			arch = "arm";
			os = "linux";			
			compression = "none";
			load = <0x50c00000>;
		};

	};
	
	configurations {
			default = "conf_linux";

			conf_linux_avz {
				description = "Linux/AVZ on virt32";
				kernel = "avz";
				fdt = "fdt_linux";
            	loadables = "avz_dt", "linux";
				ramdisk = "initrd";
			};

			conf_linux {
				kernel = "linux";
				fdt = "fdt_linux";
				ramdisk = "initrd";
			};
		
	};

};
```

## build/meta-bsp/recipes-bsp/linux/files/its/virt64_avz.its
```
/*
 * Copyright (C) 2020-2026 EDGEMTech SA <info@edgemtech.ch>
 *
 * AVZ ITS for QEMU virt64 (armv8). Carries only the AVZ hypervisor
 * binary (so3.bin) + the AVZ device tree. The guest lives in a SEPARATE
 * ITB (virt64_so3_guest.its for bsp-so3, virt64_linux_guest.its for the
 * Linux agency); both are loaded by U-Boot's guest-boot command, which
 * passes the AVZ FIT in x0 and the guest ITB in x1.
 *
 * Template: ${IB_*_PATH} placeholders are expanded to absolute build
 * paths by bsp_render_its (bsp.bbclass) at do_itb time.
 *
 * The bare path uses virt64.its (bsp-linux, IB_BOOT_CHAIN="uboot")
 * instead — see that file for the single-ITB bootm variant without AVZ.
 *
 * This program is free software; you can redistribute it and/or modify
 * it under the terms of the GNU General Public License version 2 as
 * published by the Free Software Foundation.
 *
 * This program is distributed in the hope that it will be useful,
 * but WITHOUT ANY WARRANTY; without even the implied warranty of
 * MERCHANTABILITY or FITNESS FOR A PARTICULAR PURPOSE.  See the
 * GNU General Public License for more details.
 *
 * You should have received a copy of the GNU General Public License
 * along with this program; if not, write to the Free Software
 * Foundation, Inc., 51 Franklin St, Fifth Floor, Boston, MA  02110-1301  USA
 *
 */

/dts-v1/;

/ {
	description = "AVZ Hypervisor bundle for virt64 (armv8)";

	images {

		avz {
			description = "AVZ Hypervisor (64-bit) Polymorphic SO3";
			data = /incbin/("${IB_AVZ_PATH}/so3.bin");
			type = "kernel";
			os = "linux";
			arch = "arm64";
			compression = "none";
			load = <0x40080000>;
			entry = <0x40080000>;
		};

		avz_dt {
			description = "AVZ device tree";
			data = /incbin/("${IB_AVZ_PATH}/dts/virt64_avz.dtb");
			type = "avz_dt";
			arch = "arm64";
			compression = "none";
			load = <0x46000000>;
		};
	};

	configurations {
		default = "avz";

		avz {
			description = "AVZ hypervisor on virt64";
			kernel = "avz";
			loadables = "avz_dt";
			fdt = "avz_dt";
		};
	};
};
```

## build/meta-bsp/recipes-bsp/linux/files/its/virt64_linux_guest.its
```
/*
 * Copyright (C) 2020-2026 Daniel Rossier <daniel.rossier@heig-vd.ch>
 *
 * Linux guest ITB for virt64 (armv8). Carries the Linux (agency) kernel
 * + its guest device tree + initrd. Paired with virt64_avz.itb and loaded
 * by U-Boot's e1c-boot command, which passes this ITB to AVZ in x1; AVZ's
 * loadAgency() loads the agency guest from it.
 *
 * This program is free software; you can redistribute it and/or modify
 * it under the terms of the GNU General Public License version 2 as
 * published by the Free Software Foundation.
 *
 */

/dts-v1/;

/ {
	description = "Linux guest bundle for virt64 (armv8)";

	images {

		linux {
			description = "Linux kernel (guest)";
			data = /incbin/("${IB_LINUX_PATH}/arch/arm64/boot/Image");
			type = "guest";
			arch = "arm64";
			os = "linux";
			compression = "none";
			load = <0x41000000>;
			entry = <0x41000000>;
		};

		fdt {
			description = "Linux guest device tree";
			data = /incbin/("${IB_LINUX_PATH}/arch/arm64/boot/dts/arm/virt64_guest.dtb");
			type = "flat_dt";
			arch = "arm64";
			compression = "none";
			load = <0x50000000>;
		};

		initrd {
			description = "Linux initrd";
			data = /incbin/("${IB_ROOTFS_PATH}/board/virt64/initrd.cpio.gz");
			type = "ramdisk";
			arch = "arm64";
			os = "linux";
			compression = "none";
			load = <0x50c00000>;
		};
	};

	configurations {
		default = "capsule";

		capsule {
			description = "Linux agency guest on virt64";
			loadables = "linux";
			fdt = "fdt";
			ramdisk = "initrd";
		};
	};
};
```

## build/meta-bsp/recipes-bsp/so3/files/its/rpi4_64_so3_guest.its
```
/*
 * Copyright (C) 2020-2026 Daniel Rossier <daniel.rossier@heig-vd.ch>
 *
 * SO3 guest ITB for RPi4 (64-bit). Carries the SO3 OS kernel (guest) +
 * its device tree + minimal rootfs. Paired with rpi4_64_avz.itb and
 * loaded by U-Boot's e1c-boot command, which passes this ITB to AVZ in
 * x1; AVZ's loadAgency() loads the agency guest from it.
 *
 * This program is free software; you can redistribute it and/or modify
 * it under the terms of the GNU General Public License version 2 as
 * published by the Free Software Foundation.
 *
 */

/dts-v1/;

/ {
	description = "SO3 guest bundle for RPi4 (64-bit)";

	images {

		so3 {
			description = "SO3 OS kernel (guest)";
			data = /incbin/("${IB_SO3_PATH}/so3/so3.bin");
			type = "guest";
			arch = "arm64";
			os = "linux";
			compression = "none";
			load = <0x10080000>;
			entry = <0x10080000>;
		};

		fdt {
			description = "SO3 guest device tree (AVZ-exposed)";
			data = /incbin/("${IB_SO3_PATH}/so3/dts/rpi4_64.dtb");
			type = "flat_dt";
			arch = "arm64";
			compression = "none";
			load = <0x15000000>;
		};

		ramfs {
			description = "SO3 environment minimal rootfs";
			data = /incbin/("${IB_ROOTFS_PATH}/rootfs.fat");
			type = "ramdisk";
			arch = "arm64";
			os = "linux";
			compression = "none";
			load = <0x15c00000>;
		};
	};

	configurations {
		default = "capsule";

		capsule {
			description = "SO3 guest on RPi4 64-bit";
			loadables = "so3";
			fdt = "fdt";
			ramdisk = "ramfs";
		};
	};
};
```

## build/meta-bsp/recipes-bsp/so3/files/its/virt64_so3_guest.its
```
/*
 * Copyright (C) 2020-2026 Daniel Rossier <daniel.rossier@heig-vd.ch>
 *
 * SO3 guest ITB for virt64 (armv8). Carries the SO3 OS kernel (guest) +
 * its device tree + minimal rootfs. Paired with virt64_avz.itb and
 * loaded by U-Boot's e1c-boot command, which passes this ITB to AVZ in
 * x1; AVZ's loadAgency() loads the agency guest from it.
 *
 * This program is free software; you can redistribute it and/or modify
 * it under the terms of the GNU General Public License version 2 as
 * published by the Free Software Foundation.
 *
 */

/dts-v1/;

/ {
	description = "SO3 guest bundle for virt64 (armv8)";

	images {

		so3 {
			description = "SO3 OS kernel (guest)";
			data = /incbin/("${IB_SO3_PATH}/so3/so3.bin");
			type = "guest";
			arch = "arm64";
			os = "linux";
			compression = "none";
			load = <0x41080000>;
			entry = <0x41080000>;
		};

		fdt {
			description = "SO3 guest device tree (AVZ-exposed)";
			data = /incbin/("${IB_SO3_PATH}/so3/dts/virt64.dtb");
			type = "flat_dt";
			arch = "arm64";
			compression = "none";
			load = <0x50000000>;
		};

		ramfs {
			description = "SO3 environment minimal rootfs";
			data = /incbin/("${IB_ROOTFS_PATH}/rootfs.fat");
			type = "ramdisk";
			arch = "arm64";
			os = "linux";
			compression = "none";
			load = <0x50c00000>;
		};
	};

	configurations {
		default = "capsule";

		capsule {
			description = "SO3 guest on virt64";
			loadables = "so3";
			fdt = "fdt";
			ramdisk = "ramfs";
		};
	};
};
```
