## so3/devices/serial/Kconfig
```kconfig
config NS16550
	bool "NS16550 UART"

config PL011_UART
	bool "PL011 UART serial interface"
	depends on VIRT32 || VIRT64
	depends on !SOO_SERIAL

config BCM283x_MU_UART
	bool "BCM283x mini-UART"
	depends on RPI4 || RPI4_64

config IMX_UART
	bool "Freescale i.MX UART (fsl,imx6q-uart)"
	depends on VERDIN_IMX8MP

config UART_LL_PADDR
	hex "Low-level UART base physical address"

config SOO_SERIAL
	bool "SOO Virtualized serial device (rely on vuart frontend)"
	depends on SOO && !AVZ
	select VUART_FRONTEND
```

## so3/so3/Kconfig
```kconfig
mainmenu "SO3 Polymorphic OS Configuration"
 
source "arch/Kconfig"

source "kernel/Kconfig"
 
source "devices/Kconfig" 

source "apps/Kconfig"

source "fs/Kconfig"
source "ipc/Kconfig"
source "mm/Kconfig"
 
config RTOS
	bool "RTOS-featured enabled"
 
config AVZ
	bool "AVZ SO3 Hypervisor mode (Agency Virtualizer)"
	depends on MMU

config USER_INIT_PROGRAM
	string "Specifies the initial user-space ELF executable to be started at system boot"
	default "init.elf"

choice
	prompt "Kernel Log Level"
	default LOG_LEVEL_INFO
	help
	  Select the minimum kernel log level that will be compiled and shown.
	  Messages below this level will be excluded or suppressed, helping to
	  reduce verbosity and potentially improve performance.

config LOG_LEVEL_CRITICAL
	bool "Critical"
	help
	  Only critical logs will be shown. Use this for production systems
	  where stability is key and minimal logging is preferred.

config LOG_LEVEL_ERROR
	bool "Error"
	help
	  Show only error and critical messages. Suitable for stable
	  environments where only actionable errors are logged.

config LOG_LEVEL_WARNING
	bool "Warning"
	help
	  Show warning, error, and critical messages. Helps catch
	  non-critical issues without too much verbosity.

config LOG_LEVEL_INFO
	bool "Info"
	help
	  Show informational messages, warnings, errors, and critical logs.
	  Good balance for general usage and system diagnostics.

config LOG_LEVEL_DEBUG
	bool "Debug"
	help
	  Show debug, info, warning, error, and critical messages.
	  Useful during development and troubleshooting.

config LOG_LEVEL_TRACE
	bool "Trace"
	help
	  Show all log levels including trace messages. Maximum verbosity
	  for deep debugging and detailed execution flow analysis.

config LOG_LEVEL_NONE
    bool "No Logging"
    help
      Disable all logging. CONFIG_LOG_LEVEL will be unset.
      Use this for ultra-minimal builds or maximum performance or
      if you want to enable LOG in selected files.

endchoice

config LOG_LEVEL
    int
    default 1 if LOG_LEVEL_CRITICAL
    default 2 if LOG_LEVEL_ERROR
    default 3 if LOG_LEVEL_WARNING
    default 4 if LOG_LEVEL_INFO
    default 5 if LOG_LEVEL_DEBUG
    default 6 if LOG_LEVEL_TRACE
    depends on !LOG_LEVEL_NONE

if !AVZ && !ARCH_ARM32
config SOO
	bool "Configure SO3 as a SO3 capsule (capsule)"
endif

if AVZ
config SOO
	bool "Configure AVZ to support SOO technology"

config S3C_POOL_SIZE_MB
	int "Size of the capsule (S3C) memory pool (MB)"
	default 512
	help
	  Physical memory reserved for capsule memslots, starting right after
	  the agency memslot. The pool is additionally clamped at run time to
	  the end of the platform RAM, but firmware carve-outs invisible to
	  AVZ (e.g. the VideoCore memory on the Raspberry Pi 4, typically
	  from 0x3ec00000) must be excluded here: a capsule slot overlapping
	  such a region corrupts the firmware silently.
endif

config MMU
	bool "MMU enable"
 
# SOO subsystem and drivers
source "soo/Kconfig"
```

## so3/so3/arch/arm32/Kconfig
```kconfig
if ARCH_ARM32

menu "Platform"

config KERNEL_VADDR
	 
	hex "Virtual base address of kernel space"
	
choice
  prompt "Target"
	
	config VIRT32
    		bool "QEMU virt 32-bit machine"
			select GIC_V2

	config RPI4
    		bool "Raspberry Pi 4 Model B 32-bit"
			select GIC_V2

endchoice

endmenu

endif
```

## so3/so3/arch/arm64/Kconfig
```kconfig
if ARCH_ARM64

menu "Platform"

	choice
  		prompt "Target"
	
		config VIRT64
    		bool "Generic QEMU virt64 model"
			select GIC_V2

		config RPI4_64
			bool "Raspberry Pi 4 64-bit"
			select GIC_V2

		config VERDIN_IMX8MP
			bool "Toradex Verdin iMX8MP"
			select GIC

	endchoice
		
	config VA_BITS_48
		default y
		bool "48-bit virtual address space"

endmenu

endif
```

## so3/so3/devices/net/Kconfig
```kconfig
config SMC911X
	bool "smc911x network interface"
	depends on VIRT32 || VIRT64
	depends on NET

	
	
```

## so3/so3/mm/Kconfig
```kconfig
config KERNEL_VADDR
	hex "Virtual base address of the SO3 kernel or hypervisor"
	default 0xff000000 if ARM32
	default 0x100000000000 if AVZ
	default 0xffff700000000000 if ARM64
	
config HEAP_SIZE_MB
	int "Size of the heap (MB)"
	default 8

config SYS_STACK_SIZE_KB
	int "Size of the system stack (KB)"
	default  64
	help
	  System stack size is used for kernel activities.

config THREAD_STACK_SIZE_KB
	int "Size of the thread stack (KB)"
	default  64
	help
	  Each thread has its own stack. This value is used to allocate the stack
	  for each thread. 
```

## so3/so3/soo/Kconfig
```kconfig
#
# SOO SO3 capsule configuration
#
if SOO && !AVZ

menu "SOO SO3 capsule - Smart Object Oriented subsystem"

source "soo/drivers/Kconfig"

endmenu

endif
```

## so3/so3/soo/drivers/Kconfig
```kconfig
#
# SOO SO3 capsule configuration
#

menu "SOO SO3 capsule frontend drivers"

config VDUMMY_FRONTEND
        bool "vdummy Dummy driver support debugging and testing"

config VUART_FRONTEND
	bool "vuart serial driver"

config VUIHANDLER_FRONTEND
	bool "vuihandler UI manager driver"

config VSENSELED_FRONTEND
    bool "vsenseled led matrix Sense HAT frontend"

config VSENSEJ_FRONTEND
    bool "vsensej joystick Sense HAT frontend"

config VLOGS_FRONTEND
    bool "vlogs serial driver"

config VFBDEV_FRONTEND
    bool "vfbdev framebuffer driver"

config VINPUT_FRONTEND
    bool "vinput driver for mouse and keyboard"
    select INPUT
    select SOO_INPUT

endmenu
```

## so3/target/verdin_imx8mp_avz.its
```
/*
 * Copyright (C) 2026 EDGEMTech SA <info@edgemtech.ch>
 *
 * AVZ ITB for the Toradex Verdin iMX8MP. Carries only the AVZ hypervisor
 * binary (so3.bin) + the AVZ device tree. The guest (SO3) lives in a
 * SEPARATE ITB (verdin_imx8mp_so3_guest.its); both are loaded by U-Boot's
 * e1c-boot command, which passes the AVZ FIT in x0 and the guest ITB in x1.
 *
 * This program is free software; you can redistribute it and/or modify
 * it under the terms of the GNU General Public License version 2 as
 * published by the Free Software Foundation.
 *
 */

/dts-v1/;

/ {
	description = "AVZ Hypervisor bundle for the Toradex Verdin iMX8MP";

	images {
		avz {
			description = "AVZ Hypervisor (64-bit) Polymorphic SO3";
			data = /incbin/("../../avz/so3.bin");
			type = "kernel";
			os = "linux";
			arch = "arm64";
			compression = "none";
			load = <0x40080000>;
			entry = <0x40080000>;
		};

		avz_dt {
			description = "AVZ flattened device tree blob";
			data = /incbin/("../../avz/dts/verdin-imx8mp_avz.dtb");
			type = "avz_dt";
			arch = "arm64";
			compression = "none";
			load = <0x46000000>;
		};
	};

	configurations {
		default = "avz";

		avz {
			description = "AVZ hypervisor on Verdin iMX8MP";
			kernel = "avz";
			loadables = "avz_dt";
			fdt = "avz_dt";
		};
	};
};
```
